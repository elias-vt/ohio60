## boards/shields/ohio60/Kconfig.defconfig
```kconfig
if SHIELD_OHIO60_LEFT

# Name must be less than 16 characters long!
config ZMK_KEYBOARD_NAME
    default "ohio60"

config ZMK_SPLIT_ROLE_CENTRAL
    default y

endif

if SHIELD_OHIO60_LEFT || SHIELD_OHIO60_RIGHT

config ZMK_SPLIT
    default y

endif
```

## boards/shields/ohio60/Kconfig.shield
```kconfig
# No whitespace after the comma or in your part name!
config SHIELD_OHIO60_LEFT
    def_bool $(shields_list_contains,ohio60_left)

# No whitespace after the comma or in your part name!
config SHIELD_OHIO60_RIGHT
    def_bool $(shields_list_contains,ohio60_right)
```
